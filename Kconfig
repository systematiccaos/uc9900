## Kconfig
```kconfig
# SPDX-License-Identifier: MIT

rsource "drivers/input/Kconfig"

DT_CHOSEN_CAPSLOCK_INDICATOR := zitaotech,capslock-indicator
DT_CHOSEN_LAYER_INDICATOR := zitaotech,layer-indicator

menuconfig ZMK_INDICATOR_CAPSLOCK
    bool "Caps Lock / trackpad indicator LED"
    default $(dt_chosen_enabled,$(DT_CHOSEN_CAPSLOCK_INDICATOR))
    select LED
    select LED_PWM
    select ZMK_HID_INDICATORS
    help
      Drives the trackpad backlight. On the stock uConsole firmware this light
      doubles as the Caps Lock indicator, so it is lit while the host reports
      Caps Lock as on. This is kept for compatibility with the stock behaviour.

if ZMK_INDICATOR_CAPSLOCK

config ZMK_INDICATOR_CAPSLOCK_BRT
    int "Brightness while lit, in percent"
    range 1 100
    default 100

endif # ZMK_INDICATOR_CAPSLOCK

menuconfig ZMK_INDICATOR_LED
    bool "Layer indicator LED"
    default $(dt_chosen_enabled,$(DT_CHOSEN_LAYER_INDICATOR))
    select LED
    select LED_PWM
    help
      Uses the big-button backlight as a layer indicator: off on the base layer,
      steady on layer 1, breathing on layer 2 and blinking on layer 3 and above.

if ZMK_INDICATOR_LED

config ZMK_IDICATOR_LAYER_BRT
    int "Brightness on layer 1, in percent"
    range 1 100
    default 100

config ZMK_IDICATOR_LAYER_CYCLE_MAXBRT
    int "Maximum brightness of the breathing and blinking effects, in percent"
    range 1 100
    default 100

config ZMK_IDICATOR_LAYER_CYCLE_MINBRT
    int "Minimum brightness of the breathing and blinking effects, in percent"
    range 0 100
    default 20

config ZMK_IDICATOR_LAYER_CYCLE_INTERVAL
    int "Milliseconds between breathing steps"
    default 20

config ZMK_IDICATOR_BRT_STEP
    int "Brightness change per breathing step, in percent"
    range 1 100
    default 5

config ZMK_IDICATOR_BLINK_INTERVAL
    int "Milliseconds between blink toggles"
    default 300

config ZMK_IDICATOR_ON_START
    bool "Start with the layer indicator lit"
    default n

endif # ZMK_INDICATOR_LED

config ZMK_TRACKPAD_SCROLL_MODE
    bool "Trackpad scroll mode driven by the host LED state"
    default y if DT_HAS_ZITAOTECH_INPUT_PROCESSOR_SCROLL_MODE_ENABLED
    depends on ZMK_POINTING
    depends on ZMK_HID_INDICATORS
    help
      Keeps the stock uConsole behaviour where the trackpad scrolls instead of
      moving the pointer while the host reports Caps Lock or Scroll Lock on.

if ZMK_TRACKPAD_SCROLL_MODE

config ZMK_TRACKPAD_SCROLL_DIVISOR
    int "Trackpad scroll divisor"
    range 1 128
    default 16
    help
      Higher values scroll more slowly. 16 approximates the stock firmware.

endif # ZMK_TRACKPAD_SCROLL_MODE
```

## boards/zitaotech/bb9900/Kconfig.bb9900
```kconfig
# Copyright (c) 2023 ZitaoTech
# SPDX-License-Identifier: MIT

config BOARD_BB9900
    select SOC_NRF52840_QIAA
    select ZMK_BOARD_COMPAT
```

## boards/zitaotech/bb9900/board.yml
```yaml
# Copyright (c) 2023 ZitaoTech
# SPDX-License-Identifier: MIT

board:
  name: bb9900
  full_name: uConsole 9900 USB/BLE Keyboard
  vendor: zitaotech
  socs:
    - name: nrf52840
      variants:
        - name: zmk
```

## dts/bindings/input_processors/zitaotech,input-processor-scroll-mode.yaml
```yaml
# SPDX-License-Identifier: MIT

description: |
  Trackpad scroll mode. While the host reports Caps Lock or Scroll Lock as on,
  relative X/Y motion is converted into horizontal/vertical wheel events, like
  the stock uConsole firmware. Otherwise events pass through unchanged.

compatible: "zitaotech,input-processor-scroll-mode"

include: ip_zero_param.yaml

properties:
  divisor:
    type: int
    default: 16
    description: |
      Number of sensor counts per wheel notch. Higher values scroll more
      slowly. 16 approximates the stock firmware's middle scroll speed.
```
